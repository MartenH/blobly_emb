VERSION ""

NS_ :

BS_:

BU_: h755 h735

BO_ 784 ButtonState: 4 h755
 SG_ BtnPressed : 0|32@1+ (1,0) [0|1] "" h735

BA_DEF_ BO_ "GenMsgCycleTime" INT 0 100000;
BA_DEF_DEF_ "GenMsgCycleTime" 0;
BA_ "GenMsgCycleTime" BO_ 784 100;
