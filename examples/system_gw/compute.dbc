VERSION ""

NS_ :

BS_:

BU_: domain sysnode

BO_ 288 VehSpeedFrame: 8 domain
 SG_ VehicleSpeed : 0|32@1+ (1,0) [0|4294967295] "km/h" sysnode

BA_DEF_ BO_ "GenMsgCycleTime" INT 0 100000;
BA_DEF_DEF_ "GenMsgCycleTime" 0;
BA_ "GenMsgCycleTime" BO_ 288 100;
