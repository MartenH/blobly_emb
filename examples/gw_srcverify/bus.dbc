VERSION ""

NS_ :

BS_:

BU_: Src Gw

BO_ 256 SrcFrame: 8 Src
 SG_ Speed : 0|16@1+ (0.1,0) [0|6553.5] "km/h" Gw

BO_ 512 DstFrame: 8 Gw
 SG_ Speed : 8|16@1+ (1,0) [0|65535] "km/h" Gw

BA_DEF_ BO_ "GenMsgCycleTime" INT 0 65535;
BA_ "GenMsgCycleTime" BO_ 256 20;
BA_ "GenMsgCycleTime" BO_ 512 100;
