VERSION ""

NS_ :

BS_:

BU_: sysnode domain

BO_ 288 VehSpeedFrame: 8 sysnode
 SG_ VehicleSpeed : 0|32@1+ (1,0) [0|4294967295] "km/h" domain

BO_ 289 EngineRpmFrame: 8 domain
 SG_ EngineRpm : 0|32@1+ (1,0) [0|4294967295] "rpm" sysnode
