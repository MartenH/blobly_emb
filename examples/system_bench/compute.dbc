VERSION ""

NS_ :

BS_:

BU_: sysnode domain

BO_ 288 VehSpeedFrame: 8 sysnode
 SG_ VehicleSpeed : 0|16@1+ (1,0) [0|65535] "km/h" domain

BO_ 289 EngineRpmFrame: 8 domain
 SG_ EngineRpm : 0|16@1+ (1,0) [0|65535] "rpm" sysnode
