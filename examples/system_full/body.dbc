VERSION ""

NS_ :

BS_:

BU_: sysnode zone_b

BO_ 320 BrakeStateFrame_B: 8 sysnode
 SG_ BrakeState : 0|32@1+ (1,0) [0|1] "" zone_b

BO_ 321 EngineRpmFrame_B: 8 sysnode
 SG_ EngineRpm : 0|32@1+ (1,0) [0|4294967295] "rpm" zone_b

BO_ 322 HvacCmdFrame_B: 8 sysnode
 SG_ HvacCmd : 0|32@1+ (1,0) [0|100] "%" zone_b

BO_ 323 TailgateFrame: 8 zone_b
 SG_ TailgateStatus : 0|32@1+ (1,0) [0|1] "" sysnode

BO_ 324 TempFrame: 8 zone_b
 SG_ AmbientTemp : 0|32@1+ (1,0) [0|255] "C" sysnode

BA_DEF_ BO_ "GenMsgCycleTime" INT 0 100000;
BA_DEF_DEF_ "GenMsgCycleTime" 0;
BA_ "GenMsgCycleTime" BO_ 320 50;
BA_ "GenMsgCycleTime" BO_ 321 100;
BA_ "GenMsgCycleTime" BO_ 322 200;
BA_ "GenMsgCycleTime" BO_ 323 200;
BA_ "GenMsgCycleTime" BO_ 324 500;
