VERSION ""

NS_ :

BS_:

BU_: domain sysnode

BO_ 288 VehSpeedFrame: 8 domain
 SG_ VehicleSpeed : 0|32@1+ (1,0) [0|4294967295] "km/h" sysnode

BO_ 289 EngineRpmFrame: 8 domain
 SG_ EngineRpm : 0|32@1+ (1,0) [0|4294967295] "rpm" sysnode

BO_ 290 BrakeStateFrame: 8 domain
 SG_ BrakeState : 0|32@1+ (1,0) [0|1] "" sysnode

BO_ 291 HeadlightCmdFrame: 8 domain
 SG_ HeadlightCmd : 0|32@1+ (1,0) [0|3] "" sysnode

BO_ 292 HvacCmdFrame: 8 domain
 SG_ HvacCmd : 0|32@1+ (1,0) [0|100] "%" sysnode

BO_ 293 SteeringFrame_C: 8 sysnode
 SG_ SteeringAngle : 0|32@1+ (1,0) [0|360] "deg" domain

BO_ 294 TailgateFrame_C: 8 sysnode
 SG_ TailgateStatus : 0|32@1+ (1,0) [0|1] "" domain

BO_ 295 TempFrame_C: 8 sysnode
 SG_ AmbientTemp : 0|32@1+ (1,0) [0|255] "C" domain

BA_DEF_ BO_ "GenMsgCycleTime" INT 0 100000;
BA_DEF_DEF_ "GenMsgCycleTime" 0;
BA_ "GenMsgCycleTime" BO_ 288 100;
BA_ "GenMsgCycleTime" BO_ 289 100;
BA_ "GenMsgCycleTime" BO_ 290 50;
BA_ "GenMsgCycleTime" BO_ 291 100;
BA_ "GenMsgCycleTime" BO_ 292 200;
BA_ "GenMsgCycleTime" BO_ 293 50;
BA_ "GenMsgCycleTime" BO_ 294 200;
BA_ "GenMsgCycleTime" BO_ 295 500;
