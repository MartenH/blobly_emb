VERSION ""

NS_ :

BS_:

BU_: Gw Sink

BO_ 256 SrcFrame: 8 Gw
 SG_ Speed : 0|16@1+ (1,0) [0|65535] "" Sink

BO_ 512 DstFrame: 8 Gw
 SG_ Speed : 8|16@1+ (1,0) [0|65535] "" Sink
