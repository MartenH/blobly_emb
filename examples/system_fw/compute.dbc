VERSION ""

NS_ :

BS_:

BU_: domain gw

BO_ 1024 DiagFrame: 8 domain
 SG_ DiagCode : 0|32@1+ (1,0) [0|4294967295] "" gw

BO_ 1025 PrivateFrame: 8 domain
 SG_ Secret : 0|32@1+ (1,0) [0|4294967295] "" domain

BA_DEF_ BO_ "GenMsgCycleTime" INT 0 100000;
BA_DEF_DEF_ "GenMsgCycleTime" 0;
BA_ "GenMsgCycleTime" BO_ 1024 100;
BA_ "GenMsgCycleTime" BO_ 1025 100;
