VERSION ""

NS_ :

BS_:

BU_: gw zone

BO_ 1024 DiagFrame: 8 gw
 SG_ DiagCode : 0|32@1+ (1,0) [0|4294967295] "" zone

BA_DEF_ BO_ "GenMsgCycleTime" INT 0 100000;
BA_DEF_DEF_ "GenMsgCycleTime" 0;
BA_ "GenMsgCycleTime" BO_ 1024 100;
